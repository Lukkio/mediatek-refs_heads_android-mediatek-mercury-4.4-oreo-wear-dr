## drivers/misc/mediatek/drv2605/Kconfig
```kconfig
config HAPTIC_DRV2605
	default n
	tristate "TI DRV2605 haptic driver"
	depends on I2C && SYSFS
	help
	  If you say yes here you get support for the TI DRV2605
	  haptic driver.
```

## drivers/misc/mediatek/idtp9220/Kconfig
```kconfig
config IDTP9220
	bool "idtp9220 wireless Charger"
	default n
	select REGMAP_I2C
	help
	  Say Y to include support for idtp9220 wireless Charger.
	  idtp9220 is a wireless battery charger.
	  The driver supports charger enable/disable.
	  The driver reports the charger status via the power supply framework.
	  The driver controls idtp9220 via I2C and
```
